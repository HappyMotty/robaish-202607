## Kconfig
```kconfig
# roBa 独自の速度感応型ポインタ加速 (input_processor_accel) の設定

menu "roBa Pointer Acceleration"

config ZMK_INPUT_PROCESSOR_ACCEL_MIN_FACTOR
    int "低速時の倍率(%)"
    default 100
    range 10 1000
    help
      トラックボールをゆっくり動かした時に適用する速度倍率。100で等倍(変化なし)。

config ZMK_INPUT_PROCESSOR_ACCEL_MAX_FACTOR
    int "高速時の倍率(%)"
    default 100
    range 10 1000
    help
      トラックボールを素早く動かした時に適用する速度倍率。
      MIN_FACTORと同じ値にすると加速は無効(常に等倍)になる。

config ZMK_INPUT_PROCESSOR_ACCEL_SPEED_MIN
    int "加速を開始する移動量のしきい値 (count/report)"
    default 3
    range 0 200
    help
      1回のレポートあたりの移動量がこの値以下では MIN_FACTOR が適用される。

config ZMK_INPUT_PROCESSOR_ACCEL_SPEED_MAX
    int "最大倍率に達する移動量のしきい値 (count/report)"
    default 18
    range 1 200
    help
      1回のレポートあたりの移動量がこの値以上では MAX_FACTOR が適用される。
      SPEED_MIN と SPEED_MAX の間は線形補間される。

endmenu

# roBa 独自の慣性スクロール (input_processor_scroll_inertia) の設定

menu "roBa Scroll Inertia"

config ZMK_INPUT_PROCESSOR_SCROLL_INERTIA_ENABLED
    bool "慣性スクロールを有効にする"
    default n
    help
      トラックボールで弾くようにスクロールした後、指を止めてもしばらく
      減速しながらスクロールが続く「慣性スクロール」を有効にする。

config ZMK_INPUT_PROCESSOR_SCROLL_INERTIA_DECAY_PERCENT
    int "減衰率(%) 数値が大きいほど長く滑る"
    default 80
    range 1 99
    help
      1ステップごとに速度をこの割合(%)に減衰させる。99に近いほど長く滑り、
      1に近いほどすぐ止まる。100以上は無限にスクロールし続けるため設定できない。

config ZMK_INPUT_PROCESSOR_SCROLL_INERTIA_MIN_VELOCITY
    int "停止とみなす速度のしきい値"
    default 1
    range 1 50
    help
      減衰していく速度がこの値未満になったら慣性スクロールを完全に停止する。

config ZMK_INPUT_PROCESSOR_SCROLL_INERTIA_START_THRESHOLD
    int "慣性を発生させる最小速度(弾きの強さ)"
    default 5
    range 1 100
    help
      指を止めた瞬間の速度がこの値未満の場合は、通常のゆっくりしたスクロール
      が止まっただけとみなし、慣性はつけない。大きくするほど「強く弾いた時だけ」
      慣性がかかるようになる。

config ZMK_INPUT_PROCESSOR_SCROLL_INERTIA_TICK_MS
    int "慣性スクロールの更新間隔(ms)"
    default 30
    range 10 200
    help
      慣性スクロール中、何msごとに速度を減衰させて次のスクロールを送るか。

config ZMK_INPUT_PROCESSOR_SCROLL_INERTIA_SMOOTHING
    int "なめらかさ (0=ダイレクト)"
    default 0
    range 0 90
    help
      入力の移動量を指数移動平均でならす度合い。0だとそのまま反映(ダイレクト)、
      大きいほど滑らかになるが反応が遅延する。センサーのノイズが多い
      トラックボールでは低め(10〜30程度)を推奨。離した後のスクロールの
      「効き始め」にも影響する。

endmenu
```

## dts/bindings/zmk,input-processor-accel.yaml
```yaml
description: |
  roBa custom input processor: applies speed-based pointer acceleration.
  The multiplier scales linearly between MIN_FACTOR and MAX_FACTOR (Kconfig)
  based on the per-report movement magnitude between SPEED_MIN and SPEED_MAX.

compatible: "zmk,input-processor-accel"

include: ip_zero_param.yaml

properties:
  type:
    type: int
    required: true
  codes:
    type: array
    required: true
```

## dts/bindings/zmk,input-processor-scroll-inertia.yaml
```yaml
description: |
  roBa custom input processor: adds inertial (momentum) scrolling.
  When real scroll events stop arriving, this processor keeps injecting
  synthetic scroll events with decaying velocity (Kconfig-controlled),
  simulating a "flick and coast" scrolling feel.

compatible: "zmk,input-processor-scroll-inertia"

include: ip_zero_param.yaml

properties:
  type:
    type: int
    required: true
  codes:
    type: array
    required: true
```
