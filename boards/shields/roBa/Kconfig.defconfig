## boards/shields/roBa/Kconfig.defconfig
```kconfig
if SHIELD_ROBA_R

config ZMK_KEYBOARD_NAME
    default "roBa_R"

config ZMK_SPLIT
    default y

config ZMK_SPLIT_ROLE_CENTRAL
    default y

endif

if SHIELD_ROBA_L

config ZMK_KEYBOARD_NAME
    default "roBa_L"

config ZMK_SPLIT
    default y

endif

if SHIELD_ROBA_DONGLE

config ZMK_KEYBOARD_NAME
    default "roBa"

config ZMK_SPLIT
    default y

config ZMK_SPLIT_ROLE_CENTRAL
    default y

endif

if SHIELD_ROBA_L_PERIPHERAL

config ZMK_KEYBOARD_NAME
    default "roBa_L"

config ZMK_SPLIT
    default y

endif

if SHIELD_ROBA_R_PERIPHERAL

config ZMK_KEYBOARD_NAME
    default "roBa_R"

config ZMK_SPLIT
    default y

endif
```

## config/west.yml
```yaml
manifest:
  remotes:
    - name: zmkfirmware
      url-base: https://github.com/zmkfirmware
    - name: myfork
      url-base: https://github.com/Awoofy
  projects:
    - name: zmk
      remote: zmkfirmware
      revision: v0.3-branch          # ← main から v0.3-branch に戻す（今回の修正点）
      import: app/west.yml
    - name: zmk-pmw3610-driver
      remote: myfork
      revision: main
  self:
    path: config
```
